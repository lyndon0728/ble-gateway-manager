## firmware/esp32s3/components/gw_nrf/Kconfig
```kconfig
menu "GW32 nRF recovery"
config GW_NRF_RESET_BOARD_VERIFIED
    bool "Enable reset only for a verified board configuration"
    default n
    help
        Requires confirmed schematic, open-drain reset circuit and pulse timing.
        The caller must hold a durable recovery intent and maintenance ownership.
config GW_NRF_RESET_GPIO
    int "Verified nRF reset GPIO"
    range 0 48
    default 8
    depends on GW_NRF_RESET_BOARD_VERIFIED
config GW_NRF_RESET_LOW_MS
    int "Verified reset assertion duration (ms)"
    range 1 1000
    default 10
    depends on GW_NRF_RESET_BOARD_VERIFIED
config GW_NRF_RESET_SETTLE_MS
    int "Verified release settling duration (ms)"
    range 1 10000
    default 100
    depends on GW_NRF_RESET_BOARD_VERIFIED
endmenu
```

## firmware/esp32s3/main/Kconfig.projbuild
```kconfig
menu "GW32 gateway"
config GW_REQUIRE_FLASH_ENCRYPTION
    bool "Require encrypted flash before accessing factory secrets"
    default y
    help
        Runtime check only. Does not burn eFuses or enable encryption on boot.
        Provision hardware encryption and encrypted NVS keys using the approved
        manufacturing process before deploying a production image.
config GW_FACTORY_AUTHORIZED_SETUP
    bool "Open one bounded setup window on first unconfigured boot"
    default n
config GW_SETUP_BUTTON_GPIO
    int "Verified active-low setup button GPIO (-1 disables)"
    range -1 48
    default -1
config GW_ETH_ENABLED
    bool "Enable board-verified external SPI Ethernet driver"
    default n
    help
        CH390H SPI driver. Set every GPIO from the verified target PCB before
        enabling. Never infer unverified PCB pins.
config GW_ETH_MOSI
    int "Verified CH390 MOSI GPIO"
    default -1
config GW_ETH_MISO
    int "Verified CH390 MISO GPIO"
    default -1
config GW_ETH_SCLK
    int "Verified CH390 clock GPIO"
    default -1
config GW_ETH_CS
    int "Verified CH390 chip select GPIO"
    default -1
config GW_ETH_INT
    int "Verified CH390 interrupt GPIO (-1 uses polling)"
    default -1
config GW_ETH_RESET
    int "Verified CH390 reset GPIO (-1 disables)"
    default -1
config GW_UART_TX_GPIO
    int "nRF UART TX GPIO"
    default 17
config GW_UART_RX_GPIO
    int "nRF UART RX GPIO"
    default 18
config GW_UART_RTS_GPIO
    int "nRF UART RTS GPIO"
    default 15
config GW_UART_CTS_GPIO
    int "nRF UART CTS GPIO"
    default 16
endmenu
```

## firmware/esp32s3/sdkconfig.defaults
```kconfig
CONFIG_IDF_TARGET="esp32s3"
CONFIG_ESPTOOLPY_FLASHSIZE_8MB=y
CONFIG_SPIRAM=y
CONFIG_SPIRAM_MODE_OCT=y
CONFIG_SPIRAM_SPEED_80M=y
CONFIG_SPIRAM_USE_MALLOC=y
# CONFIG_SPIRAM_IGNORE_NOTFOUND is not set
CONFIG_PARTITION_TABLE_CUSTOM=y
CONFIG_PARTITION_TABLE_CUSTOM_FILENAME="partitions.csv"
CONFIG_PARTITION_TABLE_OFFSET=0x8000
CONFIG_BOOTLOADER_APP_ROLLBACK_ENABLE=y
CONFIG_NVS_ENCRYPTION=y
CONFIG_ESP_PROTOCOMM_SUPPORT_SECURITY_VERSION_2=y
# CONFIG_ESP_PROTOCOMM_SUPPORT_SECURITY_VERSION_0 is not set
# CONFIG_ESP_PROTOCOMM_SUPPORT_SECURITY_VERSION_1 is not set
CONFIG_MBEDTLS_CERTIFICATE_BUNDLE=y
CONFIG_MBEDTLS_DYNAMIC_BUFFER=y
CONFIG_ESP_WIFI_SOFTAP_SUPPORT=y
CONFIG_ESP_WIFI_ENABLE_WPA3_SAE=y
CONFIG_ESP_MAIN_TASK_STACK_SIZE=12288
CONFIG_FREERTOS_HZ=1000
CONFIG_LWIP_SNTP_MAX_SERVERS=2
CONFIG_HTTPD_MAX_REQ_HDR_LEN=1024
CONFIG_HTTPD_MAX_URI_LEN=128
CONFIG_GW_REQUIRE_FLASH_ENCRYPTION=y
CONFIG_BT_ENABLED=y
CONFIG_BT_NIMBLE_ENABLED=y
CONFIG_BT_NIMBLE_ROLE_CENTRAL=y
CONFIG_BT_NIMBLE_ROLE_OBSERVER=y
CONFIG_BT_NIMBLE_ROLE_BROADCASTER=y
# CONFIG_BT_NIMBLE_SECURITY_ENABLE is not set
CONFIG_ESP_NETIF_SET_DNS_PER_DEFAULT_NETIF=y
```

## firmware/nrf54l15/boards/gw32/gw32_nrf54l15/Kconfig.defconfig
```kconfig
if BOARD_GW32_NRF54L15

config HW_STACK_PROTECTION
	default ARCH_HAS_STACK_PROTECTION

endif
```

## firmware/nrf54l15/boards/gw32/gw32_nrf54l15/Kconfig.gw32_nrf54l15
```kconfig
config BOARD_GW32_NRF54L15
	select SOC_NRF54L15_CPUAPP if BOARD_GW32_NRF54L15_NRF54L15_CPUAPP
```

## firmware/nrf54l15/boards/gw32/gw32_nrf54l15/board.yml
```yaml
board:
  name: gw32_nrf54l15
  full_name: GW32 October 2026 nRF54L15 coprocessor
  vendor: others
  socs:
    - name: nrf54l15
```
